## boards/shields/robot_controller/Kconfig.defconfig
```kconfig
# Copyright (c) 2025 Peter Christoffersen
# SPDX-License-Identifier: BSD-Clause-3

if SHIELD_ROBOT_CONTROLLER_STANDALONE || SHIELD_ROBOT_CONTROLLER_EMBEDDED

config GPIO
    default y

config I2C
    default y

config PWM
    default y

config DMA
    default y

config ADC
    default y

config LED
    default y

endif #  SHIELD_ROBOT_CONTROLLER_STANDALONE || SHIELD_ROBOT_CONTROLLER_EMBEDDED
```

## boards/shields/robot_controller/Kconfig.shield
```kconfig
# Copyright (c) 2025 Peter Christoffersen
# SPDX-License-Identifier: BSD-Clause-3

config SHIELD_ROBOT_CONTROLLER_STANDALONE
	def_bool $(shields_list_contains,robot_controller_standalone)

config SHIELD_ROBOT_CONTROLLER_EMBEDDED
	def_bool $(shields_list_contains,robot_controller_embedded)

config SHIELD_ROBOT_CONTROLLER_INIT_PRIORITY
	int "Init priority"
	default 91
	help
	  Shield init
```
