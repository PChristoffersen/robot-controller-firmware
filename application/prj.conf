## CMakeLists.txt
```
# Copyright (c) 2025 Peter Christoffersen
# SPDX-License-Identifier: BSD-Clause-3

cmake_minimum_required(VERSION 3.20.0)

# Set the board
set(BOARD "stm32_min_dev@blue")

# Set the shield
set(SHIELD robot_controller_standalone)
#set(SHIELD robot_controller_embedded)

# Add boards directory to the search path
set(BOARD_ROOT ${CMAKE_CURRENT_SOURCE_DIR}/..)


find_package(Zephyr REQUIRED HINTS $ENV{ZEPHYR_BASE})
project(robot_controller)

target_sources(app PRIVATE
    src/main.c
    src/analog_axis.c
    src/hid_device.c
    src/usb_device.c
    src/lamp_array.c
    src/lighting.c
    src/util.c
)

target_include_directories(app PRIVATE
    include
)
```

## Kconfig
```
# Copyright (c) 2025 Peter Christoffersen
# SPDX-License-Identifier: BSD-Clause-3

menu "Robot Controller options"

config ROBOT_CONTROLLER_USBD_MANUFACTURER
	string "USB device manufacturer string"
	default "Unknown"
	help
	  USB device manufacturer string.

config ROBOT_CONTROLLER_USBD_PRODUCT
	string "USB device product string"
	default "Robot Contoller"
	help
	  USB device product stringa.

config ROBOT_CONTROLLER_USBD_VID
    hex "USB device Vendor ID"
    default 0x1209
    help
      USB device Vendor ID. (Default is the Vendor ID for pid.codes)

config ROBOT_CONTROLLER_USBD_PID
	hex "USB device Product ID"
	default 0x0001
	help
	  USB device Product ID. (Default is pod.codes Test PID)

config ROBOT_CONTROLLER_USBD_REMOTE_WAKEUP
	bool "USB device Remote Wakeup attribute"
    default y
	help
	  Set the Remote Wakeup attribute in the configuration.

config ROBOT_CONTROLLER_USBD_MAX_POWER
	int "USB device bMaxPower value"
	default 125
	range 0 250
	help
	  bMaxPower value in the configuration in 2 mA units.


config ROBOT_CONTROLLER_MIN_INPUT_REPORT_INTERVAL_MS
	int "Minimum input report interval in milliseconds"
	default 16
	help
	  Minimum input report interval in milliseconds.

endmenu

source "Kconfig.zephyr"
```

## west.yml
```
manifest:
  remotes:
    - name: zephyrproject-rtos
      url-base: https://github.com/zephyrproject-rtos
  projects:
    - name: zephyr
      remote: zephyrproject-rtos
      # We probably want to use a specific tag or branch here
      # but the new USB stack does not seem very stable on v4.0.0
      #revision: v4.1.0
      revision: main
      clone-depth: 1
      import:
        name-allowlist:
          - cmsis
          - cmsis-dsp
          - picolibc
          - segger
          - hal_stm32
    - name: ws2812-stm32
      path: modules/ws2812-stm32
      revision: v1.1
      url: https://github.com/PChristoffersen/zephyr-ws2812-stm32.git
  self:
    path: application
```

## prj.conf
```kconfig
# Copyright (c) 2025 Peter Christoffersen
# SPDX-License-Identifier: BSD-Clause-3

# -------------------------
# Debug
#CONFIG_DEBUG=y
#CONFIG_DEBUG_INFO=y
#CONFIG_DEBUG_OPTIMIZATIONS=y
#CONFIG_DEBUG_THREAD_INFO=y
#CONFIG_SYS_HEAP_RUNTIME_STATS=y
#CONFIG_THREAD_MONITOR=y
#CONFIG_THREAD_STACK_INFO=y
#CONFIG_THREAD_RUNTIME_STATS=y

# -------------------------
# Logging
#CONFIG_LOG=y
#CONFIG_LOG_MODE_MINIMAL=y
#CONFIG_LOG_DEFAULT_LEVEL=1

#CONFIG_USBD_LOG_LEVEL_WRN=y
#CONFIG_USBD_HID_LOG_LEVEL_WRN=y
#CONFIG_UDC_DRIVER_LOG_LEVEL_WRN=y
#CONFIG_USBD_LOG_LEVEL_DBG=y
#CONFIG_GPIO_LOG_LEVEL_DBG=y
#CONFIG_PWM_LOG_LEVEL_DBG=y
#CONFIG_LED_LOG_LEVEL_DBG=y
#CONFIG_ADC_LOG_LEVEL_INF=y
#CONFIG_DMA_LOG_LEVEL_INF=y
#CONFIG_INPUT_LOG_LEVEL_DBG=y
#CONFIG_INPUT_LOG_LEVEL_INF=y
#CONFIG_NET_BUF_LOG_LEVEL_DBG=y

# -------------------------
# Space saving
CONFIG_BOOT_BANNER=n
CONFIG_UART_USE_RUNTIME_CONFIGURE=n
CONFIG_ISR_STACK_SIZE=1024
CONFIG_MAIN_STACK_SIZE=512

# -------------------------
# USB
CONFIG_USB_DEVICE_STACK_NEXT=y
CONFIG_USBD_HID_SUPPORT=y
#CONFIG_UDC_BUF_COUNT=32
#CONFIG_UDC_BUF_POOL_SIZE=2048


# -------------------------
# Input
CONFIG_INPUT=y
CONFIG_INPUT_MODE_SYNCHRONOUS=y
#CONFIG_INPUT_QUEUE_MAX_MSGS=32
#CONFIG_INPUT_THREAD_STACK_SIZE=512
#CONFIG_INPUT_THREAD_PRIORITY_OVERRIDE=y
#CONFIG_INPUT_THREAD_PRIORITY=10
#CONFIG_INPUT_EVENT_DUMP=y

# -------------------------
# Misc
CONFIG_HWINFO=y
```

## boards/stm32_min_dev.overlay
```dts
/**
 * BSD 3-Clause License
 * 
 * Copyright (c) 2025, Peter Christoffersen
 * 
 * Redistribution and use in source and binary forms, with or without
 * modification, are permitted provided that the following conditions are met:
 * 
 * 1. Redistributions of source code must retain the above copyright notice, this
 *    list of conditions and the following disclaimer.
 * 
 * 2. Redistributions in binary form must reproduce the above copyright notice,
 *    this list of conditions and the following disclaimer in the documentation
 *    and/or other materials provided with the distribution.
 * 
 * 3. Neither the name of the copyright holder nor the names of its
 *    contributors may be used to endorse or promote products derived from
 *    this software without specific prior written permission.
 * 
 * THIS SOFTWARE IS PROVIDED BY THE COPYRIGHT HOLDERS AND CONTRIBUTORS "AS IS"
 * AND ANY EXPRESS OR IMPLIED WARRANTIES, INCLUDING, BUT NOT LIMITED TO, THE
 * IMPLIED WARRANTIES OF MERCHANTABILITY AND FITNESS FOR A PARTICULAR PURPOSE ARE
 * DISCLAIMED. IN NO EVENT SHALL THE COPYRIGHT HOLDER OR CONTRIBUTORS BE LIABLE
 * FOR ANY DIRECT, INDIRECT, INCIDENTAL, SPECIAL, EXEMPLARY, OR CONSEQUENTIAL
 * DAMAGES (INCLUDING, BUT NOT LIMITED TO, PROCUREMENT OF SUBSTITUTE GOODS OR
 * SERVICES; LOSS OF USE, DATA, OR PROFITS; OR BUSINESS INTERRUPTION) HOWEVER
 * CAUSED AND ON ANY THEORY OF LIABILITY, WHETHER IN CONTRACT, STRICT LIABILITY,
 * OR TORT (INCLUDING NEGLIGENCE OR OTHERWISE) ARISING IN ANY WAY OUT OF THE USE
 * OF THIS SOFTWARE, EVEN IF ADVISED OF THE POSSIBILITY OF SUCH DAMAGE.
 */

 #include <dt-bindings/pinctrl/stm32f1-pinctrl.h>

/ {

    hid_dev_0: hid_dev_0 {
		compatible = "zephyr,hid-device";
		interface-name = "HID0";
		protocol-code = "none";
		in-report-size = <64>;
		in-polling-period-us = <1000>;
	};

};


/**
 * Increase flash size to 128kB
 * 
 * See "scripts/boards/stm32f103c8_blue_pill.cfg" in the openocd installation
 */
 &flash0 {
	reg = <0x08000000 DT_SIZE_K(128)>;
};
 
```

## src/main.c
```c
/**
 * BSD 3-Clause License
 * 
 * Copyright (c) 2025, Peter Christoffersen
 * 
 * Redistribution and use in source and binary forms, with or without
 * modification, are permitted provided that the following conditions are met:
 * 
 * 1. Redistributions of source code must retain the above copyright notice, this
 *    list of conditions and the following disclaimer.
 * 
 * 2. Redistributions in binary form must reproduce the above copyright notice,
 *    this list of conditions and the following disclaimer in the documentation
 *    and/or other materials provided with the distribution.
 * 
 * 3. Neither the name of the copyright holder nor the names of its
 *    contributors may be used to endorse or promote products derived from
 *    this software without specific prior written permission.
 * 
 * THIS SOFTWARE IS PROVIDED BY THE COPYRIGHT HOLDERS AND CONTRIBUTORS "AS IS"
 * AND ANY EXPRESS OR IMPLIED WARRANTIES, INCLUDING, BUT NOT LIMITED TO, THE
 * IMPLIED WARRANTIES OF MERCHANTABILITY AND FITNESS FOR A PARTICULAR PURPOSE ARE
 * DISCLAIMED. IN NO EVENT SHALL THE COPYRIGHT HOLDER OR CONTRIBUTORS BE LIABLE
 * FOR ANY DIRECT, INDIRECT, INCIDENTAL, SPECIAL, EXEMPLARY, OR CONSEQUENTIAL
 * DAMAGES (INCLUDING, BUT NOT LIMITED TO, PROCUREMENT OF SUBSTITUTE GOODS OR
 * SERVICES; LOSS OF USE, DATA, OR PROFITS; OR BUSINESS INTERRUPTION) HOWEVER
 * CAUSED AND ON ANY THEORY OF LIABILITY, WHETHER IN CONTRACT, STRICT LIABILITY,
 * OR TORT (INCLUDING NEGLIGENCE OR OTHERWISE) ARISING IN ANY WAY OUT OF THE USE
 * OF THIS SOFTWARE, EVEN IF ADVISED OF THE POSSIBILITY OF SUCH DAMAGE.
 */

#include <stdio.h>
#include <string.h>

#include <zephyr/kernel.h>
#include <zephyr/version.h>
#include <zephyr/drivers/hwinfo.h>
#include <zephyr/input/input.h>
#include <zephyr/logging/log.h>

LOG_MODULE_REGISTER(main);

#include "controller.h"
#include "usb_device.h"
#include "hid_device.h"
#include "lamp_array.h"
#include "lighting.h"
#include "input_mapping.h"
#include "util.h"


K_MUTEX_DEFINE(g_input_mutex);
K_CONDVAR_DEFINE(g_input_cond);
K_CONDVAR_DEFINE(g_report_cond);

static hid_gamepad_input_t g_input_state = {
    .report_id = REPORT_ID_GAMEPAD,
    .dpad = 0xF,
};
static bool g_input_state_changed = false;

static led_state_t g_led_state = 0;

static uint32_t g_idle_duration = 0;

static bool g_enabled = false;
static bool g_autonomous = true;
static bool g_suspended = false;
static bool g_report_pending = false;
K_TIMER_DEFINE(g_report_timer, NULL, NULL);


static void update_leds(led_state_t state)
{
    for (uint8_t i=0; i<CONTROLLER_LED_COUNT; i++) {
        led_set(i, (state & (1<<i)) ? 100 : 0);
    }
}

static void start_report_timer()
{
    k_timer_start(&g_report_timer, K_MSEC(CONFIG_ROBOT_CONTROLLER_MIN_INPUT_REPORT_INTERVAL_MS), K_NO_WAIT);
}


/* -----------------------------------------------------------------------------------
 * State handling
 * ----------------------------------------------------------------------------------- */

void controller_reset()
{
    k_mutex_lock(&g_input_mutex, K_FOREVER);
    if (g_enabled) {
        LOG_INF("Controller Reset");
        update_leds(g_led_state);
        lamp_array_reset();
        g_idle_duration = 0;
        g_autonomous = true;
        g_led_state = 0;
        g_input_state_changed = true;
        start_report_timer();
        k_condvar_broadcast(&g_input_cond);
    }
    k_mutex_unlock(&g_input_mutex);
}

void controller_set_enabled(bool enabled)
{
    k_mutex_lock(&g_input_mutex, K_FOREVER);
    if (enabled != g_enabled) {
        LOG_INF("Controller %s", enabled?"enabled":"disabled");
        g_enabled = enabled;
        if (enabled) {
            start_report_timer();
        }
        k_condvar_broadcast(&g_input_cond);
    }
    k_mutex_unlock(&g_input_mutex);
}

void controller_set_suspend(bool suspended)
{
    k_mutex_lock(&g_input_mutex, K_FOREVER);
    if (suspended != g_suspended) {
        g_suspended = suspended;
        if (g_enabled) {
            LOG_INF("Controller %s", suspended?"suspended":"resumed");
            if (g_suspended) {
                g_autonomous = true;
                controller_set_idle(0);
                led_strip_clear();
                lamp_array_reset();
                update_leds(0x00);
            }
            else {
                if (g_autonomous) {
                    update_leds(g_led_state);
                }
                start_report_timer();
                g_input_state_changed = true;
            }
            k_condvar_broadcast(&g_input_cond);
        }
    }
    k_mutex_unlock(&g_input_mutex);
}



int controller_set_output(const uint8_t *buffer, uint16_t bufsize)
{
    if (bufsize < sizeof(hid_gamepad_output_t)) {
        return -EINVAL;
    }

    const hid_gamepad_output_t *output = (const hid_gamepad_output_t *)buffer;

    LOG_DBG("Set Output: leds=%02x", output->leds);
    k_mutex_lock(&g_input_mutex, K_FOREVER);
    if (g_led_state != output->leds) {
        g_led_state = output->leds;
        if (g_autonomous && !g_suspended) {
            update_leds(g_led_state);
        }
    }
    k_mutex_unlock(&g_input_mutex);

    return -ENOTSUP;
}


void controller_set_idle(const uint32_t duration)
{
    LOG_DBG("Set Idle: duration=%u", duration);
    k_mutex_lock(&g_input_mutex, K_FOREVER);
    if (g_idle_duration != duration) {
        g_idle_duration = duration;
        k_condvar_broadcast(&g_input_cond);
    }
    k_mutex_unlock(&g_input_mutex);
}


uint32_t controller_get_idle()
{
    LOG_DBG("Get Idle: duration=%u", g_idle_duration);
    return g_idle_duration;
}





void controller_set_autonomous_mode(bool enabled)
{
    k_mutex_lock(&g_input_mutex, K_FOREVER);
    if (enabled != g_autonomous) {
        g_autonomous = enabled;
        led_strip_clear();
        if (g_autonomous) {
            update_leds(g_led_state);
        }
        else {
            update_leds(0x00);
        }
    }
    k_mutex_unlock(&g_input_mutex);
}

bool controller_is_autonomous_mode()
{
    return g_autonomous;
}


void controller_input_report_done()
{
    k_mutex_lock(&g_input_mutex, K_FOREVER);
    g_report_pending = false;
    k_condvar_broadcast(&g_report_cond);
    k_mutex_unlock(&g_input_mutex);
}



/* -----------------------------------------------------------------------------------
 * Input Event handling
 * ----------------------------------------------------------------------------------- */

static void input_cb(struct input_event *event, void *user_data)
{
    if (k_mutex_lock(&g_input_mutex, K_MSEC(20)) != 0) {
        // Drop event if it takes too long to acquire the mutex
        return;
    }
    static dpad_state_t dpad_state = {0};
    switch (event->type) {
        case INPUT_EV_KEY:
            LOG_DBG("Key Event: code=0x%x, value=%d", event->code, event->value);
            g_input_state_changed |= input_process_key(event, &g_input_state, &dpad_state);
            break;
        case INPUT_EV_REL:
            LOG_DBG("Relative Event: code=0x%x, value=%d", event->code, event->value);
            g_input_state_changed |= input_process_dial(event, &g_input_state);
            break;
        case INPUT_EV_ABS:
            LOG_DBG("Absolute Event: code=0x%x, value=%d", event->code, event->value);
            g_input_state_changed |= input_process_axis(event, &g_input_state);
            break;
    }
    if (g_input_state_changed) {
        g_input_state.dpad = input_dpad_map(&dpad_state);
        k_condvar_broadcast(&g_input_cond);
    }
    k_mutex_unlock(&g_input_mutex);
}

INPUT_CALLBACK_DEFINE(NULL, input_cb, NULL);



/* -----------------------------------------------------------------------------------
 * Main loop
 * ----------------------------------------------------------------------------------- */

static void banner()
{
	printf("\n");
	printf("---------------------------------\n");
	printf("Zephyr OS version: %s\n", KERNEL_VERSION_STRING);
	printf("---------------------------------\n");
	printf("\n");

	print_reset_cause();
	hwinfo_clear_reset_cause();

	printf("\n\n");
}


int main(void)
{
    int ret;

	banner();

	lighting_init();
	controller_hid_device_init();
	controller_usb_device_init();

    // Initialization done - lower priority and start main loop
    k_thread_priority_set(k_current_get(), K_LOWEST_APPLICATION_THREAD_PRIO);

    k_mutex_lock(&g_input_mutex, K_FOREVER);
    start_report_timer();
    while (true) {
        if (!g_enabled || g_suspended) {
            LOG_DBG("Wait... enabled=%d, suspended=%d", g_enabled, g_suspended);
            k_mutex_unlock(&g_input_mutex);
            k_msleep(100);
            k_mutex_lock(&g_input_mutex, K_FOREVER);
            continue;
        }

        k_mutex_unlock(&g_input_mutex);
        k_timer_status_sync(&g_report_timer);
        k_mutex_lock(&g_input_mutex, K_FOREVER);

        // Wait for input event or idle timeout
        if (!g_input_state_changed) {
    		k_condvar_wait(&g_input_cond, &g_input_mutex, g_idle_duration>0 ? K_MSEC(g_idle_duration) : K_FOREVER);
        }
        if (!g_enabled || g_suspended) {
            continue;
        }

        if (g_input_state_changed || g_idle_duration>0) {
            LOG_DBG("Submit input_state_changed=%d idle_state=%u  enabled=%d,  suspended=%d", g_input_state_changed, g_idle_duration, g_enabled, g_suspended);
            
            // Wait for previous report to be sent
            while (g_report_pending) {
                k_condvar_wait(&g_report_cond, &g_input_mutex, K_FOREVER);
            }

            // Submit gamepad state
            ret = controller_hid_submit_gamepad((const uint8_t *)&g_input_state, sizeof(g_input_state));
            if (ret != 0) {
                LOG_ERR("Failed to submit gamepad state: %d", ret);
                break;
            }
            start_report_timer();
            g_input_state.dial = 0; // Reset dial relative value
            g_input_state_changed = false; // Clear input state change flag
            g_report_pending = true; // Set report pending flag
        }
    }
    k_mutex_unlock(&g_input_mutex);

	return 0;
}
```

## include/controller.h
```c
/**
 * BSD 3-Clause License
 * 
 * Copyright (c) 2025, Peter Christoffersen
 * 
 * Redistribution and use in source and binary forms, with or without
 * modification, are permitted provided that the following conditions are met:
 * 
 * 1. Redistributions of source code must retain the above copyright notice, this
 *    list of conditions and the following disclaimer.
 * 
 * 2. Redistributions in binary form must reproduce the above copyright notice,
 *    this list of conditions and the following disclaimer in the documentation
 *    and/or other materials provided with the distribution.
 * 
 * 3. Neither the name of the copyright holder nor the names of its
 *    contributors may be used to endorse or promote products derived from
 *    this software without specific prior written permission.
 * 
 * THIS SOFTWARE IS PROVIDED BY THE COPYRIGHT HOLDERS AND CONTRIBUTORS "AS IS"
 * AND ANY EXPRESS OR IMPLIED WARRANTIES, INCLUDING, BUT NOT LIMITED TO, THE
 * IMPLIED WARRANTIES OF MERCHANTABILITY AND FITNESS FOR A PARTICULAR PURPOSE ARE
 * DISCLAIMED. IN NO EVENT SHALL THE COPYRIGHT HOLDER OR CONTRIBUTORS BE LIABLE
 * FOR ANY DIRECT, INDIRECT, INCIDENTAL, SPECIAL, EXEMPLARY, OR CONSEQUENTIAL
 * DAMAGES (INCLUDING, BUT NOT LIMITED TO, PROCUREMENT OF SUBSTITUTE GOODS OR
 * SERVICES; LOSS OF USE, DATA, OR PROFITS; OR BUSINESS INTERRUPTION) HOWEVER
 * CAUSED AND ON ANY THEORY OF LIABILITY, WHETHER IN CONTRACT, STRICT LIABILITY,
 * OR TORT (INCLUDING NEGLIGENCE OR OTHERWISE) ARISING IN ANY WAY OUT OF THE USE
 * OF THIS SOFTWARE, EVEN IF ADVISED OF THE POSSIBILITY OF SUCH DAMAGE.
 */

#pragma once

#include <stdint.h>

#if CONFIG_SHIELD_ROBOT_CONTROLLER_STANDALONE
#define CONTROLLER_BUTTON_COUNT 11
#define CONTROLLER_LED_COUNT 6
#define CONTROLLER_BUTTON_1_USAGE HID_USAGE_EXTRA_BUTTON_1
#define CONTROLLER_BUTTON_2_USAGE HID_USAGE_EXTRA_BUTTON_2
#define CONTROLLER_BUTTON_3_USAGE HID_USAGE_EXTRA_BUTTON_3
#define CONTROLLER_BUTTON_4_USAGE HID_USAGE_EXTRA_BUTTON_4
#define CONTROLLER_BUTTON_5_USAGE HID_USAGE_EXTRA_BUTTON_5
#define CONTROLLER_BUTTON_6_USAGE HID_USAGE_EXTRA_BUTTON_6
#define CONTROLLER_LED_1_USAGE HID_USAGE_LED_PLAYER1
#define CONTROLLER_LED_2_USAGE HID_USAGE_LED_PLAYER2
#define CONTROLLER_LED_3_USAGE HID_USAGE_LED_PLAYER3
#define CONTROLLER_LED_4_USAGE HID_USAGE_LED_PLAYER4
#define CONTROLLER_LED_5_USAGE HID_USAGE_LED_LINUX_SLEEP
#define CONTROLLER_LED_6_USAGE HID_USAGE_LED_LINUX_MUTE
#endif
#if CONFIG_SHIELD_ROBOT_CONTROLLER_EMBEDDED
#define CONTROLLER_BUTTON_COUNT 9
#define CONTROLLER_LED_GPIO_COUNT 2
#define CONTROLLER_LED_COUNT 4
#define CONTROLLER_BUTTON_1_USAGE HID_USAGE_EXTRA_BUTTON_1
#define CONTROLLER_BUTTON_2_USAGE HID_USAGE_EXTRA_BUTTON_2
#define CONTROLLER_BUTTON_3_USAGE HID_USAGE_GAMEPAD_BUTTON_MODE
#define CONTROLLER_BUTTON_4_USAGE HID_USAGE_GAMEPAD_BUTTON_START
#define CONTROLLER_LED_1_USAGE HID_USAGE_LED_LINUX_SLEEP
#define CONTROLLER_LED_2_USAGE HID_USAGE_LED_LINUX_MUTE
#define CONTROLLER_LED_3_USAGE HID_USAGE_LED_LINUX_MISC
#define CONTROLLER_LED_4_USAGE HID_USAGE_LED_LINUX_MAIL
#endif

#define CONTROLLER_WS2812_COUNT 4

#define CONTROLLER_AXIS_MIN -2048
#define CONTROLLER_AXIS_MAX 2047
#define CONTROLLER_AXIS_COUNT 6
#define CONTROLLER_AXIS_CHANGE_THRESHOLD 10
#define CONTROLLER_AXIS_DEADZONE 130
#define CONTROLLER_AXIS_Z_DEADZONE 160

#define CONTROLLER_DIAL_MIN -7
#define CONTROLLER_DIAL_MAX 7


/*
 * Controller dimensions
 */
#define UM_PER_MM 1000

#define CONTROLLER_POD_WIDTH_MM 82
#define CONTROLLER_DEPTH_MM 130

#define CONTROLLER_LED_STRIP_DISTANCE_MM 13

#if CONFIG_SHIELD_ROBOT_CONTROLLER_STANDALONE
#define CONTROLLER_CENTER_WIDTH_MM 80
#define CONTROLLER_WIDTH_MM (CONTROLLER_CENTER_WIDTH_MM + 2*CONTROLLER_POD_WIDTH_MM)
#define CONTROLLER_LED_STRIP_X_OFFSET_MM (21+CONTROLLER_POD_WIDTH_MM)
#define CONTROLLER_LED_STRIP_Y_OFFSET_MM (18)
#define CONTROLLER_LED_STRIP_Z_OFFSET_MM 0
#define CONTROLLER_LED_BUTTON_1_X_OFFSET_MM (27+CONTROLLER_POD_WIDTH_MM)
#define CONTROLLER_LED_BUTTON_1_Y_OFFSET_MM (73)
#define CONTROLLER_LED_BUTTON_1_Z_OFFSET_MM 0
#define CONTROLLER_LED_BUTTON_2_X_OFFSET_MM (CONTROLLER_WIDTH_MM-CONTROLLER_LED_BUTTON_1_X_OFFSET_MM)
#define CONTROLLER_LED_BUTTON_2_Y_OFFSET_MM CONTROLLER_LED_BUTTON_1_Y_OFFSET_MM
#define CONTROLLER_LED_BUTTON_2_Z_OFFSET_MM CONTROLLER_LED_BUTTON_1_Z_OFFSET_MM
#define CONTROLLER_LED_BUTTON_3_X_OFFSET_MM (18+CONTROLLER_POD_WIDTH_MM)
#define CONTROLLER_LED_BUTTON_3_Y_OFFSET_MM (97)
#define CONTROLLER_LED_BUTTON_3_Z_OFFSET_MM 0
#define CONTROLLER_LED_BUTTON_4_X_OFFSET_MM (CONTROLLER_WIDTH_MM-CONTROLLER_LED_BUTTON_3_X_OFFSET_MM)
#define CONTROLLER_LED_BUTTON_4_Y_OFFSET_MM CONTROLLER_LED_BUTTON_3_Y_OFFSET_MM
#define CONTROLLER_LED_BUTTON_4_Z_OFFSET_MM CONTROLLER_LED_BUTTON_3_Z_OFFSET_MM
#define CONTROLLER_LED_INDICATOR_1_X_OFFSET_MM (50+CONTROLLER_POD_WIDTH_MM)
#define CONTROLLER_LED_INDICATOR_1_Y_OFFSET_MM (18)
#define CONTROLLER_LED_INDICATOR_1_Z_OFFSET_MM 0
#define CONTROLLER_LED_INDICATOR_2_X_OFFSET_MM (16+CONTROLLER_LED_INDICATOR_1_X_OFFSET_MM)
#define CONTROLLER_LED_INDICATOR_2_Y_OFFSET_MM CONTROLLER_LED_INDICATOR_1_Y_OFFSET_MM
#define CONTROLLER_LED_INDICATOR_2_Z_OFFSET_MM CONTROLLER_LED_INDICATOR_1_Z_OFFSET_MM
#endif
#if CONFIG_SHIELD_ROBOT_CONTROLLER_EMBEDDED
#define CONTROLLER_CENTER_WIDTH_MM 160
#define CONTROLLER_WIDTH_MM (CONTROLLER_CENTER_WIDTH_MM + 2*CONTROLLER_POD_WIDTH_MM)
#define CONTROLLER_BUTTON_ROW_Y_OFFSET_MM 18
#define CONTROLLER_LED_STRIP_X_OFFSET_MM (36+CONTROLLER_POD_WIDTH_MM)
#define CONTROLLER_LED_STRIP_Y_OFFSET_MM CONTROLLER_BUTTON_ROW_Y_OFFSET_MM
#define CONTROLLER_LED_STRIP_Z_OFFSET_MM 0
#define CONTROLLER_LED_BUTTON_1_X_OFFSET_MM (18+CONTROLLER_POD_WIDTH_MM)  
#define CONTROLLER_LED_BUTTON_1_Y_OFFSET_MM CONTROLLER_BUTTON_ROW_Y_OFFSET_MM
#define CONTROLLER_LED_BUTTON_1_Z_OFFSET_MM 0
#define CONTROLLER_LED_BUTTON_2_X_OFFSET_MM (106+CONTROLLER_POD_WIDTH_MM)
#define CONTROLLER_LED_BUTTON_2_Y_OFFSET_MM CONTROLLER_BUTTON_ROW_Y_OFFSET_MM
#define CONTROLLER_LED_BUTTON_2_Z_OFFSET_MM 0
#define CONTROLLER_LED_BUTTON_3_X_OFFSET_MM (18+CONTROLLER_LED_BUTTON_2_X_OFFSET_MM)
#define CONTROLLER_LED_BUTTON_3_Y_OFFSET_MM CONTROLLER_BUTTON_ROW_Y_OFFSET_MM
#define CONTROLLER_LED_BUTTON_3_Z_OFFSET_MM 0
#define CONTROLLER_LED_BUTTON_4_X_OFFSET_MM (18+CONTROLLER_LED_BUTTON_3_X_OFFSET_MM)
#define CONTROLLER_LED_BUTTON_4_Y_OFFSET_MM CONTROLLER_BUTTON_ROW_Y_OFFSET_MM
#define CONTROLLER_LED_BUTTON_4_Z_OFFSET_MM 0
#endif
#define CONTROLLER_HEIGHT_MM 60




void controller_reset();
void controller_set_enabled(bool enabled);
void controller_set_suspend(bool enabled);

int controller_set_output(const uint8_t *buffer, uint16_t bufsize);
void controller_set_idle(const uint32_t duration);
uint32_t controller_get_idle();

void controller_set_autonomous_mode(bool autonomous);
bool controller_is_autonomous_mode();
void controller_input_report_done();
```

## include/hid_descriptor.h
```c
/**
 * BSD 3-Clause License
 * 
 * Copyright (c) 2025, Peter Christoffersen
 * 
 * Redistribution and use in source and binary forms, with or without
 * modification, are permitted provided that the following conditions are met:
 * 
 * 1. Redistributions of source code must retain the above copyright notice, this
 *    list of conditions and the following disclaimer.
 * 
 * 2. Redistributions in binary form must reproduce the above copyright notice,
 *    this list of conditions and the following disclaimer in the documentation
 *    and/or other materials provided with the distribution.
 * 
 * 3. Neither the name of the copyright holder nor the names of its
 *    contributors may be used to endorse or promote products derived from
 *    this software without specific prior written permission.
 * 
 * THIS SOFTWARE IS PROVIDED BY THE COPYRIGHT HOLDERS AND CONTRIBUTORS "AS IS"
 * AND ANY EXPRESS OR IMPLIED WARRANTIES, INCLUDING, BUT NOT LIMITED TO, THE
 * IMPLIED WARRANTIES OF MERCHANTABILITY AND FITNESS FOR A PARTICULAR PURPOSE ARE
 * DISCLAIMED. IN NO EVENT SHALL THE COPYRIGHT HOLDER OR CONTRIBUTORS BE LIABLE
 * FOR ANY DIRECT, INDIRECT, INCIDENTAL, SPECIAL, EXEMPLARY, OR CONSEQUENTIAL
 * DAMAGES (INCLUDING, BUT NOT LIMITED TO, PROCUREMENT OF SUBSTITUTE GOODS OR
 * SERVICES; LOSS OF USE, DATA, OR PROFITS; OR BUSINESS INTERRUPTION) HOWEVER
 * CAUSED AND ON ANY THEORY OF LIABILITY, WHETHER IN CONTRACT, STRICT LIABILITY,
 * OR TORT (INCLUDING NEGLIGENCE OR OTHERWISE) ARISING IN ANY WAY OUT OF THE USE
 * OF THIS SOFTWARE, EVEN IF ADVISED OF THE POSSIBILITY OF SUCH DAMAGE.
 */

#pragma once

#include <stdint.h>

#include <zephyr/usb/class/usb_hid.h>

#define HID_VAL_BYTE0(x) ((x) & 0xFF)
#define HID_VAL_BYTE1(x) (((x) & 0xFF00)>>8)
#define HID_VAL_BYTE2(x) (((x) & 0xFF0000)>>16)
#define HID_VAL_BYTE3(x) (((x) & 0xFF000000)>>24)


#define HID_PHYSICAL_MIN8(a) HID_ITEM(HID_ITEM_TAG_PHYSICAL_MIN, HID_ITEM_TYPE_GLOBAL, 1), a
#define HID_PHYSICAL_MAX8(a) HID_ITEM(HID_ITEM_TAG_PHYSICAL_MAX, HID_ITEM_TYPE_GLOBAL, 1), a
#define HID_PHYSICAL_MIN16(a, b) HID_ITEM(HID_ITEM_TAG_PHYSICAL_MIN, HID_ITEM_TYPE_GLOBAL, 2), a, b
#define HID_PHYSICAL_MAX16(a, b) HID_ITEM(HID_ITEM_TAG_PHYSICAL_MAX, HID_ITEM_TYPE_GLOBAL, 2), a, b

#define HID_LOGICAL_MIN8_(a) HID_LOGICAL_MIN8(((uint8_t)a))
#define HID_LOGICAL_MAX8_(a) HID_LOGICAL_MAX8(((uint8_t)a))
#define HID_LOGICAL_MIN16_(a) HID_LOGICAL_MIN16(HID_VAL_BYTE0(((uint16_t)a)), HID_VAL_BYTE1(((uint16_t)a)))
#define HID_LOGICAL_MAX16_(a) HID_LOGICAL_MAX16(HID_VAL_BYTE0(((uint16_t)a)), HID_VAL_BYTE1(((uint16_t)a)))
#define HID_LOGICAL_MIN32_(a) HID_LOGICAL_MIN32(HID_VAL_BYTE0(((uint32_t)a)), HID_VAL_BYTE1(((uint32_t)a)), HID_VAL_BYTE2(((uint32_t)a)), HID_VAL_BYTE3(((uint32_t)a)))
#define HID_LOGICAL_MAX32_(a) HID_LOGICAL_MAX32(HID_VAL_BYTE0(((uint32_t)a)), HID_VAL_BYTE1(((uint32_t)a)), HID_VAL_BYTE2(((uint32_t)a)), HID_VAL_BYTE3(((uint32_t)a)))

#define HID_PHYSICAL_MIN16_(a) HID_PHYSICAL_MIN16(HID_VAL_BYTE0(((uint16_t)a)), HID_VAL_BYTE1(((uint16_t)a)))
#define HID_PHYSICAL_MAX16_(a) HID_PHYSICAL_MAX16(HID_VAL_BYTE0(((uint16_t)a)), HID_VAL_BYTE1(((uint16_t)a)))

#define HID_UNIT(a)	HID_ITEM(HID_ITEM_TAG_UNIT, HID_ITEM_TYPE_GLOBAL, 1), a
#define HID_UNIT_EXPONENT(a) HID_ITEM(HID_ITEM_TAG_UNIT_EXPONENT, HID_ITEM_TYPE_GLOBAL, 1), a


/** --------------------------------------------------------------
 * HID 1.11 - 6.2.2.5 Input, Output, and Feature Items
 * --------------------------------------------------------------- */
#define HID_DATA             (0<<0)
#define HID_CONSTANT         (1<<0)

#define HID_ARRAY            (0<<1)
#define HID_VARIABLE         (1<<1)

#define HID_ABSOLUTE         (0<<2)
#define HID_RELATIVE         (1<<2)

#define HID_WRAP_NO          (0<<3)
#define HID_WRAP             (1<<3)

#define HID_LINEAR           (0<<4)
#define HID_NONLINEAR        (1<<4)

#define HID_PREFERRED_STATE  (0<<5)
#define HID_PREFERRED_NO     (1<<5)

#define HID_NO_NULL_POSITION (0<<6)
#define HID_NULL_STATE       (1<<6)

#define HID_NON_VOLATILE     (0<<7)
#define HID_VOLATILE         (1<<7)

#define HID_BITFIELD         (0<<8)
#define HID_BUFFERED_BYTES   (1<<8)



/* ---------------------------------------------------------------
 * HUT 1.6 - Generic Desktop Page (0x01)
 * --------------------------------------------------------------- */
#define HID_USAGE_GEN_DESKTOP_Z 0x32
#define HID_USAGE_GEN_DESKTOP_RX 0x33
#define HID_USAGE_GEN_DESKTOP_RY 0x34
#define HID_USAGE_GEN_DESKTOP_RZ 0x35
#define HID_USAGE_GEN_DESKTOP_DIAL 0x37
#define HID_USAGE_GEN_DESKTOP_HAT_SWITCH 0x39



/* ---------------------------------------------------------------
 * HUT 1.12 - Usage Pages
 * --------------------------------------------------------------- */
#define HID_USAGE_LIGHTING 0x59


/* ---------------------------------------------------------------
 * Button Usages
 * --------------------------------------------------------------- */
#define HID_USAGE_GEN_BUTTON_1  0x01
#define HID_USAGE_GEN_BUTTON_2  0x02
#define HID_USAGE_GEN_BUTTON_3  0x03
#define HID_USAGE_GEN_BUTTON_4  0x04
#define HID_USAGE_GEN_BUTTON_5  0x05
#define HID_USAGE_GEN_BUTTON_6  0x06
#define HID_USAGE_GEN_BUTTON_7  0x07
#define HID_USAGE_GEN_BUTTON_8  0x08
#define HID_USAGE_GEN_BUTTON_9  0x09
#define HID_USAGE_GEN_BUTTON_10 0x0A
#define HID_USAGE_GEN_BUTTON_12 0x0B
#define HID_USAGE_GEN_BUTTON_13 0x0C
#define HID_USAGE_GEN_BUTTON_14 0x0D
#define HID_USAGE_GEN_BUTTON_15 0x0E
#define HID_USAGE_GEN_BUTTON_16 0x0F

#define HID_USAGE_GAMEPAD_BUTTON_SOUTH  HID_USAGE_GEN_BUTTON_1
#define HID_USAGE_GAMEPAD_BUTTON_A      HID_USAGE_GAMEPAD_SOUTH
#define HID_USAGE_GAMEPAD_BUTTON_EAST   HID_USAGE_GEN_BUTTON_2
#define HID_USAGE_GAMEPAD_BUTTON_B      HID_USAGE_GAMEPAD_EAST
#define HID_USAGE_GAMEPAD_BUTTON_C      HID_USAGE_GEN_BUTTON_3
#define HID_USAGE_GAMEPAD_BUTTON_NORTH  HID_USAGE_GEN_BUTTON_4
#define HID_USAGE_GAMEPAD_BUTTON_X      HID_USAGE_GAMEPAD_NORTH
#define HID_USAGE_GAMEPAD_BUTTON_WEST   HID_USAGE_GEN_BUTTON_5
#define HID_USAGE_GAMEPAD_BUTTON_Y      HID_USAGE_GAMEPAD_WEST
#define HID_USAGE_GAMEPAD_BUTTON_Z      HID_USAGE_GEN_BUTTON_6
#define HID_USAGE_GAMEPAD_BUTTON_L1     HID_USAGE_GEN_BUTTON_7
#define HID_USAGE_GAMEPAD_BUTTON_R1     HID_USAGE_GEN_BUTTON_8
#define HID_USAGE_GAMEPAD_BUTTON_L2     HID_USAGE_GEN_BUTTON_9
#define HID_USAGE_GAMEPAD_BUTTON_R2     HID_USAGE_GEN_BUTTON_10
#define HID_USAGE_GAMEPAD_BUTTON_SELECT HID_USAGE_GEN_BUTTON_12
#define HID_USAGE_GAMEPAD_BUTTON_START  HID_USAGE_GEN_BUTTON_13
#define HID_USAGE_GAMEPAD_BUTTON_MODE   HID_USAGE_GEN_BUTTON_14
#define HID_USAGE_GAMEPAD_BUTTON_THUMBL HID_USAGE_GEN_BUTTON_15
#define HID_USAGE_GAMEPAD_BUTTON_THUMBR HID_USAGE_GEN_BUTTON_16

#define HID_USAGE_JOYSTICK_BUTTON_TRIGGER   HID_USAGE_GEN_BUTTON_1
#define HID_USAGE_JOYSTICK_BUTTON_THUMB     HID_USAGE_GEN_BUTTON_2
#define HID_USAGE_JOYSTICK_BUTTON_THUMB2    HID_USAGE_GEN_BUTTON_3
#define HID_USAGE_JOYSTICK_BUTTON_TOP       HID_USAGE_GEN_BUTTON_4
#define HID_USAGE_JOYSTICK_BUTTON_TOP2      HID_USAGE_GEN_BUTTON_5
#define HID_USAGE_JOYSTICK_BUTTON_PINKIE    HID_USAGE_GEN_BUTTON_6
#define HID_USAGE_JOYSTICK_BUTTON_BASE      HID_USAGE_GEN_BUTTON_7
#define HID_USAGE_JOYSTICK_BUTTON_BASE2     HID_USAGE_GEN_BUTTON_8
#define HID_USAGE_JOYSTICK_BUTTON_BASE3     HID_USAGE_GEN_BUTTON_9
#define HID_USAGE_JOYSTICK_BUTTON_BASE4     HID_USAGE_GEN_BUTTON_10
#define HID_USAGE_JOYSTICK_BUTTON_BASE5     HID_USAGE_GEN_BUTTON_11
#define HID_USAGE_JOYSTICK_BUTTON_BASE6     HID_USAGE_GEN_BUTTON_12
#define HID_USAGE_JOYSTICK_BUTTON_DEAD      HID_USAGE_GEN_BUTTON_13

#define HID_USAGE_EXTRA_BUTTON_1    0x11
#define HID_USAGE_EXTRA_BUTTON_2    0x12
#define HID_USAGE_EXTRA_BUTTON_3    0x13
#define HID_USAGE_EXTRA_BUTTON_4    0x14
#define HID_USAGE_EXTRA_BUTTON_5    0x15
#define HID_USAGE_EXTRA_BUTTON_6    0x16
#define HID_USAGE_EXTRA_BUTTON_7    0x17
#define HID_USAGE_EXTRA_BUTTON_8    0x18
#define HID_USAGE_EXTRA_BUTTON_9    0x19
#define HID_USAGE_EXTRA_BUTTON_10   0x1A


/* ---------------------------------------------------------------
 * HUT 1.12 - LED Page (0x08)
 * --------------------------------------------------------------- */
/* HID Usage values support by the linux driver */
#define HID_USAGE_LED_LINUX_NUML     0x01 /*   "Num Lock"                 */
#define HID_USAGE_LED_LINUX_CAPSL    0x02 /*   "Caps Lock"                */
#define HID_USAGE_LED_LINUX_SCROLLL  0x03 /*   "Scroll Lock"              */
#define HID_USAGE_LED_LINUX_COMPOSE  0x04 /*   "Compose"                  */
#define HID_USAGE_LED_LINUX_KANA     0x05 /*   "Kana"                     */
#define HID_USAGE_LED_LINUX_SLEEP    0x27 /*   "Stand-By"                 */
#define HID_USAGE_LED_LINUX_SUSPEND  0x4c /*   "System Suspend"           */
#define HID_USAGE_LED_LINUX_MUTE     0x09 /*   "Mute"                     */
#define HID_USAGE_LED_LINUX_MISC     0x4b /*   "Generic Indicator"        */
#define HID_USAGE_LED_LINUX_MAIL     0x19 /*   "Message Waiting"          */
#define HID_USAGE_LED_LINUX_CHARGING 0x4d /*   "External Power Connected" */

#define HID_USAGE_LED_PLAYER1        0x61
#define HID_USAGE_LED_PLAYER2        0x62
#define HID_USAGE_LED_PLAYER3        0x63
#define HID_USAGE_LED_PLAYER4        0x64
#define HID_USAGE_LED_PLAYER5        0x65
#define HID_USAGE_LED_PLAYER6        0x66
#define HID_USAGE_LED_PLAYER7        0x67
#define HID_USAGE_LED_PLAYER8        0x68


/** --------------------------------------------------------------
 * HUT 1.12 - Lighting And Illumination Page (0x59)
 * --------------------------------------------------------------- */

#define HID_USAGE_LIGHTING_LAMP_ARRAY                           0x01
#define HID_USAGE_LIGHTING_LAMP_ARRAY_ATTRIBUTES_REPORT         0x02
#define HID_USAGE_LIGHTING_LAMP_COUNT                           0x03
#define HID_USAGE_LIGHTING_BOUNDING_BOX_WIDTH_IN_MICROMETERS    0x04
#define HID_USAGE_LIGHTING_BOUNDING_BOX_HEIGHT_IN_MICROMETERS   0x05
#define HID_USAGE_LIGHTING_BOUNDING_BOX_DEPTH_IN_MICROMETERS    0x06
#define HID_USAGE_LIGHTING_LAMP_ARRAY_KIND                      0x07
#define HID_USAGE_LIGHTING_MIN_UPDATE_INTERVAL_IN_MICROSECONDS  0x08
#define HID_USAGE_LIGHTING_LAMP_ATTRIBUTES_REQUEST_REPORT       0x20
#define HID_USAGE_LIGHTING_LAMP_ID                              0x21
#define HID_USAGE_LIGHTING_LAMP_ATTRIBUTES_RESPONSE_REPORT      0x22
#define HID_USAGE_LIGHTING_POSITION_X_IN_MICROMETERS            0x23
#define HID_USAGE_LIGHTING_POSITION_Y_IN_MICROMETERS            0x24
#define HID_USAGE_LIGHTING_POSITION_Z_IN_MICROMETERS            0x25
#define HID_USAGE_LIGHTING_LAMP_PURPOSES                        0x26
#define HID_USAGE_LIGHTING_UPDATE_LATENCY_IN_MICROSECONDS       0x27
#define HID_USAGE_LIGHTING_RED_LEVEL_COUNT                      0x28
#define HID_USAGE_LIGHTING_GREEN_LEVEL_COUNT                    0x29
#define HID_USAGE_LIGHTING_BLUE_LEVEL_COUNT                     0x2A
#define HID_USAGE_LIGHTING_INTENSITY_LEVEL_COUNT                0x2B
#define HID_USAGE_LIGHTING_IS_PROGRAMMABLE                      0x2C
#define HID_USAGE_LIGHTING_INPUT_BINDING                        0x2D
#define HID_USAGE_LIGHTING_LAMP_MULTI_UPDATE_REPORT             0x50
#define HID_USAGE_LIGHTING_RED_UPDATE_CHANNEL                   0x51
#define HID_USAGE_LIGHTING_GREEN_UPDATE_CHANNEL                 0x52
#define HID_USAGE_LIGHTING_BLUE_UPDATE_CHANNEL                  0x53
#define HID_USAGE_LIGHTING_INTENSITY_UPDATE_CHANNEL             0x54
#define HID_USAGE_LIGHTING_LAMP_UPDATE_FLAGS                    0x55
#define HID_USAGE_LIGHTING_LAMP_RANGE_UPDATE_REPORT             0x60
#define HID_USAGE_LIGHTING_LAMP_ID_START                        0x61
#define HID_USAGE_LIGHTING_LAMP_ID_END                          0x62
#define HID_USAGE_LIGHTING_LAMP_ARRAY_CONTROL_REPORT            0x70
#define HID_USAGE_LIGHTING_AUTONOMOUS_MODE                      0x71
```

## include/hid_device.h
```c
/**
 * BSD 3-Clause License
 * 
 * Copyright (c) 2025, Peter Christoffersen
 * 
 * Redistribution and use in source and binary forms, with or without
 * modification, are permitted provided that the following conditions are met:
 * 
 * 1. Redistributions of source code must retain the above copyright notice, this
 *    list of conditions and the following disclaimer.
 * 
 * 2. Redistributions in binary form must reproduce the above copyright notice,
 *    this list of conditions and the following disclaimer in the documentation
 *    and/or other materials provided with the distribution.
 * 
 * 3. Neither the name of the copyright holder nor the names of its
 *    contributors may be used to endorse or promote products derived from
 *    this software without specific prior written permission.
 * 
 * THIS SOFTWARE IS PROVIDED BY THE COPYRIGHT HOLDERS AND CONTRIBUTORS "AS IS"
 * AND ANY EXPRESS OR IMPLIED WARRANTIES, INCLUDING, BUT NOT LIMITED TO, THE
 * IMPLIED WARRANTIES OF MERCHANTABILITY AND FITNESS FOR A PARTICULAR PURPOSE ARE
 * DISCLAIMED. IN NO EVENT SHALL THE COPYRIGHT HOLDER OR CONTRIBUTORS BE LIABLE
 * FOR ANY DIRECT, INDIRECT, INCIDENTAL, SPECIAL, EXEMPLARY, OR CONSEQUENTIAL
 * DAMAGES (INCLUDING, BUT NOT LIMITED TO, PROCUREMENT OF SUBSTITUTE GOODS OR
 * SERVICES; LOSS OF USE, DATA, OR PROFITS; OR BUSINESS INTERRUPTION) HOWEVER
 * CAUSED AND ON ANY THEORY OF LIABILITY, WHETHER IN CONTRACT, STRICT LIABILITY,
 * OR TORT (INCLUDING NEGLIGENCE OR OTHERWISE) ARISING IN ANY WAY OUT OF THE USE
 * OF THIS SOFTWARE, EVEN IF ADVISED OF THE POSSIBILITY OF SUCH DAMAGE.
 */

#pragma once

#include <zephyr/kernel.h>


int controller_hid_device_init();

int controller_hid_submit_gamepad(const uint8_t *const report, uint16_t size);
```

## include/hid_gamepad.h
```c
/**
 * BSD 3-Clause License
 * 
 * Copyright (c) 2025, Peter Christoffersen
 * 
 * Redistribution and use in source and binary forms, with or without
 * modification, are permitted provided that the following conditions are met:
 * 
 * 1. Redistributions of source code must retain the above copyright notice, this
 *    list of conditions and the following disclaimer.
 * 
 * 2. Redistributions in binary form must reproduce the above copyright notice,
 *    this list of conditions and the following disclaimer in the documentation
 *    and/or other materials provided with the distribution.
 * 
 * 3. Neither the name of the copyright holder nor the names of its
 *    contributors may be used to endorse or promote products derived from
 *    this software without specific prior written permission.
 * 
 * THIS SOFTWARE IS PROVIDED BY THE COPYRIGHT HOLDERS AND CONTRIBUTORS "AS IS"
 * AND ANY EXPRESS OR IMPLIED WARRANTIES, INCLUDING, BUT NOT LIMITED TO, THE
 * IMPLIED WARRANTIES OF MERCHANTABILITY AND FITNESS FOR A PARTICULAR PURPOSE ARE
 * DISCLAIMED. IN NO EVENT SHALL THE COPYRIGHT HOLDER OR CONTRIBUTORS BE LIABLE
 * FOR ANY DIRECT, INDIRECT, INCIDENTAL, SPECIAL, EXEMPLARY, OR CONSEQUENTIAL
 * DAMAGES (INCLUDING, BUT NOT LIMITED TO, PROCUREMENT OF SUBSTITUTE GOODS OR
 * SERVICES; LOSS OF USE, DATA, OR PROFITS; OR BUSINESS INTERRUPTION) HOWEVER
 * CAUSED AND ON ANY THEORY OF LIABILITY, WHETHER IN CONTRACT, STRICT LIABILITY,
 * OR TORT (INCLUDING NEGLIGENCE OR OTHERWISE) ARISING IN ANY WAY OUT OF THE USE
 * OF THIS SOFTWARE, EVEN IF ADVISED OF THE POSSIBILITY OF SUCH DAMAGE.
 */

#pragma once

#include <stdint.h>

#include "hid_types.h"

typedef int16_t axis_value_t;
typedef uint8_t led_state_t;


typedef struct HID_STRUCT_ATTR {
    uint16_t select: 1;
    uint16_t south: 1;
    uint16_t east: 1;
    uint16_t north: 1;
    uint16_t west: 1;
    uint16_t extra1: 1;
    uint16_t extra2: 1;
    uint16_t extra3: 1;
    uint16_t extra4: 1;
    uint16_t extra5: 1;
    uint16_t extra6: 1;
    uint16_t _padding: 5;
} button_state_t;


typedef struct HID_STRUCT_ATTR {
    hid_report_id_t report_id;

    // Joysticks
    axis_value_t axis[6];

    // Direction Pad
    uint8_t dpad: 4;

    // Dial
    int8_t dial: 4;

    // Buttons
    button_state_t buttons;
} hid_gamepad_input_t;


typedef struct HID_STRUCT_ATTR {
    hid_report_id_t report_id;
    led_state_t leds;
} hid_gamepad_output_t;
```

## include/hid_lamp_array.h
```c
/**
 * BSD 3-Clause License
 * 
 * Copyright (c) 2025, Peter Christoffersen
 * 
 * Redistribution and use in source and binary forms, with or without
 * modification, are permitted provided that the following conditions are met:
 * 
 * 1. Redistributions of source code must retain the above copyright notice, this
 *    list of conditions and the following disclaimer.
 * 
 * 2. Redistributions in binary form must reproduce the above copyright notice,
 *    this list of conditions and the following disclaimer in the documentation
 *    and/or other materials provided with the distribution.
 * 
 * 3. Neither the name of the copyright holder nor the names of its
 *    contributors may be used to endorse or promote products derived from
 *    this software without specific prior written permission.
 * 
 * THIS SOFTWARE IS PROVIDED BY THE COPYRIGHT HOLDERS AND CONTRIBUTORS "AS IS"
 * AND ANY EXPRESS OR IMPLIED WARRANTIES, INCLUDING, BUT NOT LIMITED TO, THE
 * IMPLIED WARRANTIES OF MERCHANTABILITY AND FITNESS FOR A PARTICULAR PURPOSE ARE
 * DISCLAIMED. IN NO EVENT SHALL THE COPYRIGHT HOLDER OR CONTRIBUTORS BE LIABLE
 * FOR ANY DIRECT, INDIRECT, INCIDENTAL, SPECIAL, EXEMPLARY, OR CONSEQUENTIAL
 * DAMAGES (INCLUDING, BUT NOT LIMITED TO, PROCUREMENT OF SUBSTITUTE GOODS OR
 * SERVICES; LOSS OF USE, DATA, OR PROFITS; OR BUSINESS INTERRUPTION) HOWEVER
 * CAUSED AND ON ANY THEORY OF LIABILITY, WHETHER IN CONTRACT, STRICT LIABILITY,
 * OR TORT (INCLUDING NEGLIGENCE OR OTHERWISE) ARISING IN ANY WAY OUT OF THE USE
 * OF THIS SOFTWARE, EVEN IF ADVISED OF THE POSSIBILITY OF SUCH DAMAGE.
 */

#pragma once

#include <stdint.h>

#include "hid_types.h"

#define HID_STRUCT_ATTR __attribute__ ((packed))


typedef enum {
    LAMP_ARRAY_KIND_UNDEFINED         = 0x00,
    LAMP_ARRAY_KIND_KEYBOARD          = 0x01,
    LAMP_ARRAY_KIND_MOUSE             = 0x02,
    LAMP_ARRAY_KIND_GAME_CONTROLLER   = 0x03,
    LAMP_ARRAY_KIND_PERIPHERAL        = 0x04,
    LAMP_ARRAY_KIND_SCENE             = 0x05,
    LAMP_ARRAY_KIND_NOTIFICATION      = 0x06,
    LAMP_ARRAY_KIND_CHASSIS           = 0x07,
    LAMP_ARRAY_KIND_WEARABLE          = 0x08,
    LAMP_ARRAY_KIND_FURNITURE         = 0x09,
    LAMP_ARRAY_KIND_ART               = 0x0A,
    LAMP_ARRAY_KIND_VENDOR_DEFINED_FIRST = 0x10000,
    LAMP_ARRAY_KIND_VENDOR_DEFINED_LAST = 0xFFFFFFFF
} tusb_desc_lamp_array_kind_t;

typedef enum {
    LAMP_PURPOSE_CONTROL      = 0x00,
    LAMP_PURPOSE_ACCENT       = 0x01,
    LAMP_PURPOSE_BRANDING     = 0x02,
    LAMP_PURPOSE_STATUS       = 0x03,
    LAMP_PURPOSE_ILLUMINATION = 0x04,
    LAMP_PURPOSE_PRESENTATION = 0x05,
    LAMP_PURPOSE_VENDOR_DEFINED_FIRST = 0x10000,
    LAMP_PURPOSE_VENDOR_DEFINED_LAST = 0xFFFFFFFF
} tusb_desc_lamp_purpose_t;



typedef enum {
    LAMP_ARRAY_FLAG_UPDATE_COMPLETE = 0x01,
} hid_lamp_update_flags_t;



typedef uint16_t hid_lamp_id_t;

typedef struct HID_STRUCT_ATTR {
    uint8_t red;
    uint8_t green;
    uint8_t blue;
    uint8_t intensity;
} hid_lamp_color_t;


typedef struct HID_STRUCT_ATTR {
    hid_report_id_t report_id;
    uint16_t lamp_count; // Number of lamps associated with this array

    uint32_t width;  // Bounding box width in micrometers
    uint32_t height; // Bounding box height in micrometers
    uint32_t depth;  // Bounding box depth in micrometers

    uint32_t kind; // Kind of lamp array
    uint32_t min_update_interval; // minimal update interval in microseconds
} hid_lamp_array_attributes_report_t;

typedef struct HID_STRUCT_ATTR {
    hid_report_id_t report_id;
    hid_lamp_id_t lamp_id;
} hid_lamp_attributes_request_t;


typedef struct HID_STRUCT_ATTR {
    hid_report_id_t report_id;
    hid_lamp_id_t lamp_id;

    uint32_t position_x; // x position in micrometers relative to bounding box
    uint32_t position_y; // y position in micrometers relative to bounding box
    uint32_t position_z; // z position in micrometers relative to bounding box

    uint32_t update_latency; // update latency in microseconds
    uint32_t purpose; // Purpose of the lamp

    uint8_t red_level_count; // Number of red levels supported by the lamp
    uint8_t green_level_count; // Number of green levels supported by the lamp
    uint8_t blue_level_count; // Number of blue levels supported by the lamp
    uint8_t intensity_level_count; // Number of intensity levels supported by the lamp

    uint8_t is_programmable; // 1 if the lamp has programmble colors, 0 otherwise
    uint8_t input_binding; // Keyboard* Usages from the Keyboard/Keypad UsagePage (0x07), or Button* Usages from Button UsagePage (0x09)
} hid_lamp_attributes_response_t;


typedef struct HID_STRUCT_ATTR {
    hid_report_id_t report_id;

    uint8_t lamp_count;
    hid_lamp_update_flags_t flags;
    hid_lamp_id_t lamp_ids[8];
    hid_lamp_color_t color[8];
} hid_lamp_multi_update_t;

typedef struct HID_STRUCT_ATTR {
    hid_report_id_t report_id;
    hid_lamp_update_flags_t flags;
    hid_lamp_id_t lamp_id_start;
    hid_lamp_id_t lamp_id_end;
    hid_lamp_color_t color;
} hid_lamp_range_update_t;


typedef struct HID_STRUCT_ATTR {
    hid_report_id_t report_id;
    uint8_t autonomous;
} hid_lamp_array_control_t;
```

## include/hid_types.h
```c
/**
 * BSD 3-Clause License
 * 
 * Copyright (c) 2025, Peter Christoffersen
 * 
 * Redistribution and use in source and binary forms, with or without
 * modification, are permitted provided that the following conditions are met:
 * 
 * 1. Redistributions of source code must retain the above copyright notice, this
 *    list of conditions and the following disclaimer.
 * 
 * 2. Redistributions in binary form must reproduce the above copyright notice,
 *    this list of conditions and the following disclaimer in the documentation
 *    and/or other materials provided with the distribution.
 * 
 * 3. Neither the name of the copyright holder nor the names of its
 *    contributors may be used to endorse or promote products derived from
 *    this software without specific prior written permission.
 * 
 * THIS SOFTWARE IS PROVIDED BY THE COPYRIGHT HOLDERS AND CONTRIBUTORS "AS IS"
 * AND ANY EXPRESS OR IMPLIED WARRANTIES, INCLUDING, BUT NOT LIMITED TO, THE
 * IMPLIED WARRANTIES OF MERCHANTABILITY AND FITNESS FOR A PARTICULAR PURPOSE ARE
 * DISCLAIMED. IN NO EVENT SHALL THE COPYRIGHT HOLDER OR CONTRIBUTORS BE LIABLE
 * FOR ANY DIRECT, INDIRECT, INCIDENTAL, SPECIAL, EXEMPLARY, OR CONSEQUENTIAL
 * DAMAGES (INCLUDING, BUT NOT LIMITED TO, PROCUREMENT OF SUBSTITUTE GOODS OR
 * SERVICES; LOSS OF USE, DATA, OR PROFITS; OR BUSINESS INTERRUPTION) HOWEVER
 * CAUSED AND ON ANY THEORY OF LIABILITY, WHETHER IN CONTRACT, STRICT LIABILITY,
 * OR TORT (INCLUDING NEGLIGENCE OR OTHERWISE) ARISING IN ANY WAY OUT OF THE USE
 * OF THIS SOFTWARE, EVEN IF ADVISED OF THE POSSIBILITY OF SUCH DAMAGE.
 */

#pragma once

#include <stdint.h>

#define HID_STRUCT_ATTR __attribute__ ((packed))

typedef uint8_t hid_report_id_t;

enum {
    REPORT_ID_GAMEPAD = 1,
    REPORT_ID_FEATURE_LAMP_ARRAY_ATTRIBUTES,
    REPORT_ID_FEATURE_LAMP_ATTRIBUTES_REQUEST,
    REPORT_ID_FEATURE_LAMP_ATTRIBUTES,
    REPORT_ID_FEATURE_LAMP_MULTI_UPDATE,
    REPORT_ID_FEATURE_LAMP_RANGE_UPDATE,
    REPORT_ID_FEATURE_LAMP_ARRAY_CONTROL,
};
```

## include/lamp_array.h
```c
/**
 * BSD 3-Clause License
 * 
 * Copyright (c) 2025, Peter Christoffersen
 * 
 * Redistribution and use in source and binary forms, with or without
 * modification, are permitted provided that the following conditions are met:
 * 
 * 1. Redistributions of source code must retain the above copyright notice, this
 *    list of conditions and the following disclaimer.
 * 
 * 2. Redistributions in binary form must reproduce the above copyright notice,
 *    this list of conditions and the following disclaimer in the documentation
 *    and/or other materials provided with the distribution.
 * 
 * 3. Neither the name of the copyright holder nor the names of its
 *    contributors may be used to endorse or promote products derived from
 *    this software without specific prior written permission.
 * 
 * THIS SOFTWARE IS PROVIDED BY THE COPYRIGHT HOLDERS AND CONTRIBUTORS "AS IS"
 * AND ANY EXPRESS OR IMPLIED WARRANTIES, INCLUDING, BUT NOT LIMITED TO, THE
 * IMPLIED WARRANTIES OF MERCHANTABILITY AND FITNESS FOR A PARTICULAR PURPOSE ARE
 * DISCLAIMED. IN NO EVENT SHALL THE COPYRIGHT HOLDER OR CONTRIBUTORS BE LIABLE
 * FOR ANY DIRECT, INDIRECT, INCIDENTAL, SPECIAL, EXEMPLARY, OR CONSEQUENTIAL
 * DAMAGES (INCLUDING, BUT NOT LIMITED TO, PROCUREMENT OF SUBSTITUTE GOODS OR
 * SERVICES; LOSS OF USE, DATA, OR PROFITS; OR BUSINESS INTERRUPTION) HOWEVER
 * CAUSED AND ON ANY THEORY OF LIABILITY, WHETHER IN CONTRACT, STRICT LIABILITY,
 * OR TORT (INCLUDING NEGLIGENCE OR OTHERWISE) ARISING IN ANY WAY OUT OF THE USE
 * OF THIS SOFTWARE, EVEN IF ADVISED OF THE POSSIBILITY OF SUCH DAMAGE.
 */

#pragma once

#include <stdint.h>

int lamp_array_reset();

int lamp_array_attributes_response(uint8_t *buffer, uint16_t bufsize);
int lamp_attributes_request(const uint8_t *buffer, uint16_t bufsize);
int lamp_attributes_response(uint8_t *buffer, uint16_t bufsize);
int lamp_multi_update(const uint8_t *buffer, uint16_t bufsize);
int lamp_range_update(const uint8_t *buffer, uint16_t bufsize);
int lamp_array_control(const uint8_t *buffer, uint16_t bufsize);
```

## include/usb_device.h
```c
/**
 * BSD 3-Clause License
 * 
 * Copyright (c) 2025, Peter Christoffersen
 * 
 * Redistribution and use in source and binary forms, with or without
 * modification, are permitted provided that the following conditions are met:
 * 
 * 1. Redistributions of source code must retain the above copyright notice, this
 *    list of conditions and the following disclaimer.
 * 
 * 2. Redistributions in binary form must reproduce the above copyright notice,
 *    this list of conditions and the following disclaimer in the documentation
 *    and/or other materials provided with the distribution.
 * 
 * 3. Neither the name of the copyright holder nor the names of its
 *    contributors may be used to endorse or promote products derived from
 *    this software without specific prior written permission.
 * 
 * THIS SOFTWARE IS PROVIDED BY THE COPYRIGHT HOLDERS AND CONTRIBUTORS "AS IS"
 * AND ANY EXPRESS OR IMPLIED WARRANTIES, INCLUDING, BUT NOT LIMITED TO, THE
 * IMPLIED WARRANTIES OF MERCHANTABILITY AND FITNESS FOR A PARTICULAR PURPOSE ARE
 * DISCLAIMED. IN NO EVENT SHALL THE COPYRIGHT HOLDER OR CONTRIBUTORS BE LIABLE
 * FOR ANY DIRECT, INDIRECT, INCIDENTAL, SPECIAL, EXEMPLARY, OR CONSEQUENTIAL
 * DAMAGES (INCLUDING, BUT NOT LIMITED TO, PROCUREMENT OF SUBSTITUTE GOODS OR
 * SERVICES; LOSS OF USE, DATA, OR PROFITS; OR BUSINESS INTERRUPTION) HOWEVER
 * CAUSED AND ON ANY THEORY OF LIABILITY, WHETHER IN CONTRACT, STRICT LIABILITY,
 * OR TORT (INCLUDING NEGLIGENCE OR OTHERWISE) ARISING IN ANY WAY OUT OF THE USE
 * OF THIS SOFTWARE, EVEN IF ADVISED OF THE POSSIBILITY OF SUCH DAMAGE.
 */

#pragma once

#include <stdint.h>
#include <zephyr/usb/usbd.h>

int controller_usb_device_init();
```
